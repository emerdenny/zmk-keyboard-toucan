#include <behaviors.dtsi>
#include <dt-bindings/zmk/keys.h>
#include <dt-bindings/zmk/behaviors.h>
#include <dt-bindings/zmk/pointing.h>
#include <dt-bindings/zmk/bt.h>
#include <dt-bindings/zmk/outputs.h>

#include "helper.h"

#include "42.h"
/* https://github.com/urob/zmk-config/blob/main/config/base.keymap */
#define KEYS_L LT0 LT1 LT2 LT3 LT4 LT5 LM0 LM1 LM2 LM3 LM4 LM5 LB0 LB1 LB2 LB3 LB4 LB5
#define KEYS_R RT0 RT1 RT2 RT3 RT4 RT5 RM0 RM1 RM2 RM3 RM4 RM5 RB0 RB1 RB2 RB3 RB4 RB5
#define THUMBS LH2 LH1 LH0 RH0 RH1 RH2

#define BASE 0
#define NAV  1
#define SYM  2
#define ADJ  3
#define MED  4
#define NUM  5
#define MOU  6

ZMK_MACRO(shalt, bindings = <&macro_press &kp RSHFT &kp RALT>, <&macro_release &kp RSHFT &kp RALT> ;)
ZMK_MACRO(galt, bindings = <&macro_press &kp RGUI &kp RALT>, <&macro_release &kp RGUI &kp RALT> ;)

ZMK_MACRO(mvscr,
            bindings
                = <&macro_press &kp LGUI &kp LALT>
                , <&macro_tap &kp S>
                , <&macro_release &kp LGUI &kp LALT>
                ;
)

#define MAKE_MACROTAP(NAME, HOLD_BEHAVIOR, MACRO)                                         \
  ZMK_HOLD_TAP(NAME, bindings = <HOLD_BEHAVIOR>, <MACRO>; flavor = "tap-preferred";       \
               tapping-term-ms = <200>;)                                                  \

ZMK_MACRO(last_workspace,
            bindings
                = <&macro_press &kp LGUI &kp LCTRL>
                , <&macro_tap &kp TAB>
                , <&macro_release &kp LGUI &kp LCTRL>
                ;
)
MAKE_MACROTAP(gt_last_workspace, &galt, &last_workspace)
#define LWKSP() &gt_last_workspace 0 0

ZMK_MACRO(next_group_window,
            bindings
                = <&macro_press &kp LGUI &kp LCTRL>
                , <&macro_tap &kp LEFT>
                , <&macro_release &kp LGUI &kp LCTRL>
                ;
)
MAKE_MACROTAP(next_group_window_taphold, &kp, &next_group_window)
#define NGW(KEYCODE) &next_group_window_taphold KEYCODE 0

ZMK_MACRO(previous_group_window,
            bindings
                = <&macro_press &kp LGUI &kp LCTRL>
                , <&macro_tap &kp RIGHT>
                , <&macro_release &kp LGUI &kp LCTRL>
                ;
)
MAKE_MACROTAP(previous_group_window_taphold, &shalt, &previous_group_window)
#define PGW() &previous_group_window_taphold 0 0


/ {
    /* https://zmk.dev/docs/keymaps/behaviors/hold-tap?examples=home_row_mods#custom-hold-tap-examples */
    behaviors {
        hml: home_row_mod_left {
            compatible = "zmk,behavior-hold-tap";
            #binding-cells = <2>;
            flavor = "balanced";
            require-prior-idle-ms = <150>;
            tapping-term-ms = <280>;
            quick-tap-ms = <175>;
            bindings = <&kp>, <&kp>;
            hold-trigger-key-positions = <KEYS_R THUMBS>; // List of keys on the right side of the keyboard
            hold-trigger-on-release;
        };
        hmr: home_row_mod_right {
            compatible = "zmk,behavior-hold-tap";
            #binding-cells = <2>;
            flavor = "balanced";
            require-prior-idle-ms = <150>;
            tapping-term-ms = <280>;
            quick-tap-ms = <225>;
            bindings = <&kp>, <&kp>;
            hold-trigger-key-positions = <KEYS_L THUMBS>; // List of keys on the left side of the keyboard
            hold-trigger-on-release;
        };
        tlt: thumb_layer_tap {
            compatible = "zmk,behavior-hold-tap";
            #binding-cells = <2>;
            flavor = "tap-preferred";
            tapping-term-ms = <200>;
            bindings = <&mo>, <&kp>;
            display-name = "Layer-Tap";
        };
    };

    /* conditional_layers { */
    /*     compatible = "zmk,conditional-layers"; */
    /*     tri_layer { */
    /*         if-layers = <1 2>; */
    /*         then-layer = <3>; */
    /*     }; */
    /* }; */

    macros {
        cycle_grp: cycle_grp {
            compatible = "zmk,behavior-macro";
            #binding-cells = <0>;
            bindings
                = <&macro_press &kp LGUI &kp LALT>
                , <&macro_tap &kp TAB>
                , <&macro_release &kp LGUI &kp LALT>
                ;
        };

        focus: focus {
            compatible = "zmk,behavior-macro-one-param";
            #binding-cells = <1>;
            bindings
                = <&macro_press &kp LGUI>
                , <&macro_param_1to1>
                , <&macro_tap &kp MACRO_PLACEHOLDER>
                , <&macro_release &kp LGUI>
                ;
        };

        wksp: wksp {
            compatible = "zmk,behavior-macro-one-param";
            #binding-cells = <1>;
            bindings
                = <&macro_press &kp LGUI>
                , <&macro_param_1to1>
                , <&macro_tap &kp MACRO_PLACEHOLDER>
                , <&macro_release &kp LGUI>
                ;
        };

        vim_end: vim_end {
            compatible = "zmk,behavior-macro";
            #binding-cells = <0>;
            bindings = <&kp G >, <&kp UNDER>;
        };
    };

    keymap {
        compatible = "zmk,keymap";

        base {
            display-name = "BASE";
            bindings = <
/* ╭─────────────┬─────────────┬─────────────┬─────────────┬─────────────┬─────────────╮ ╭─────────────┬─────────────┬─────────────┬─────────────┬─────────────┬─────────────╮ */
     &kp EQUAL     &kp Q         &kp W         &kp E         &kp R         &kp T           &kp Y         &kp U         &kp I         &kp O         &kp P         &kp MINUS          
/* ├─────────────┼─────────────┼─────────────┼─────────────┼─────────────┼─────────────┤ ├─────────────┼─────────────┼─────────────┼─────────────┼─────────────┼─────────────┤ */
     &kp BSPC      &hml LALT A   &hml LGUI S   &hml LCTRL D  &hml LSHFT F  &kp G           &kp H         &hmr RSHFT J  &hmr LCTRL K  &hmr LGUI L  &hmr LALT SEMI &kp SQT          
/* ├─────────────┼─────────────┼─────────────┼─────────────┼─────────────┼─────────────┤ ├─────────────┼─────────────┼─────────────┼─────────────┼─────────────┼─────────────┤ */
     &kp TAB       &kp Z         &kp X         &kp C         &kp V         &kp B           &kp N         &kp M         &kp COMMA     &kp DOT       &kp FSLH      &kp BSLH          
/* ╰─────────────┴─────────────┴─────────────┴─────────────┼─────────────┼─────────────┤ ├─────────────┼─────────────┼─────────────┴─────────────┴─────────────┴─────────────╯ */
                                              &tlt MOU BSPC &tlt NAV SPACE &tlt NUM TAB    &tlt MED RET  &tlt SYM ESC  &tlt ADJ DEL
/*                                           ╰─────────────┴─────────────┴─────────────╯ ╰─────────────┴─────────────┴─────────────╯ */
            >;
        };

        nav {
            display-name = "NAV";
            bindings = <
/* ╭─────────────┬─────────────┬─────────────┬─────────────┬─────────────┬─────────────╮ ╭─────────────┬─────────────┬─────────────┬─────────────┬─────────────┬─────────────╮ */
     &bt BT_CLR   &bt BT_SEL 0   &bt BT_SEL 1  &bt BT_SEL 2  &bt BT_SEL 3  &bt BT_SEL 4    &wksp N1      &wksp N2      &wksp N3      &wksp N4      &wksp N5      &wksp N6
/* ├─────────────┼─────────────┼─────────────┼─────────────┼─────────────┼─────────────┤ ├─────────────┼─────────────┼─────────────┼─────────────┼─────────────┼─────────────┤ */
     &trans        &trans        &mvscr        &trans        &trans        &trans          &kp LEFT      &kp DOWN      &kp UP        &kp RIGHT     &trans        &trans
/* ├─────────────┼─────────────┼─────────────┼─────────────┼─────────────┼─────────────┤ ├─────────────┼─────────────┼─────────────┼─────────────┼─────────────┼─────────────┤ */
     &soft_off     &trans        &trans        &trans        &trans        &trans          &focus LEFT   &focus DOWN   &focus UP     &focus RIGHT  &trans        &trans
/* ╰─────────────┴─────────────┴─────────────┴─────────────┼─────────────┼─────────────┤ ├─────────────┼─────────────┼─────────────┴─────────────┴─────────────┴─────────────╯ */
                                               &trans        &trans        &trans          LWKSP()        NGW(RGUI)     PGW()
/*                                           ╰─────────────┴─────────────┴─────────────╯ ╰─────────────┴─────────────┴─────────────╯ */
            >;
        };

        sym {
            display-name = "SYM";
            bindings = <
/* ╭─────────────┬─────────────┬─────────────┬─────────────┬─────────────┬─────────────╮ ╭─────────────┬─────────────┬─────────────┬─────────────┬─────────────┬─────────────╮ */
     &kp GRAVE     &kp EXCL      &kp AT        &kp LBRC      &kp RBRC      &kp PRCNT       &trans        &trans        &trans        &trans        &trans        &trans      
/* ├─────────────┼─────────────┼─────────────┼─────────────┼─────────────┼─────────────┤ ├─────────────┼─────────────┼─────────────┼─────────────┼─────────────┼─────────────┤ */
     &kp PLUS      &kp CARET     &vim_end      &kp LBKT      &kp RBKT      &kp HASH        &trans        &kp LSHFT     &trans        &trans        &trans        &trans      
/* ├─────────────┼─────────────┼─────────────┼─────────────┼─────────────┼─────────────┤ ├─────────────┼─────────────┼─────────────┼─────────────┼─────────────┼─────────────┤ */
     &caps_word    &kp N0        &kp DLLR      &kp LPAR      &kp RPAR      &kp PIPE        &trans        &trans        &trans        &trans        &trans        &trans      
/* ╰─────────────┴─────────────┴─────────────┴─────────────┼─────────────┼─────────────┤ ├─────────────┼─────────────┼─────────────┴─────────────┴─────────────┴─────────────╯ */
                                               &trans        &kp COLON     &kp AMPS        &trans        &trans        &trans
/*                                           ╰─────────────┴─────────────┴─────────────╯ ╰─────────────┴─────────────┴─────────────╯ */
            >;
        };

        adj {
            display-name = "ADJ";
            bindings = <
                &mo TAB   &trans &kp F7 &kp F8 &kp F9 &kp F12   &kp C_VOL_DN &kp C_MUTE  &kp C_VOL_UP &trans &trans &kp BSPC
                &kp LCTRL &trans &kp F4 &kp F5 &kp F6 &kp F11   &trans       &trans      &trans       &trans &trans &trans
                &bt LSHFT &trans &kp F1 &kp F2 &kp F3 &kp F10   &trans       &trans      &trans       &trans &trans &trans
                                   &kp LGUI &mo NAV &kp SPACE   &kp RET &mo 2 &kp RALT
            >;
        };

        media {
            display-name = "MED";
            bindings = <
                &mo TAB   &trans &kp F7 &kp F8 &kp F9 &kp F12   &kp C_VOL_DN &kp C_MUTE  &kp C_VOL_UP &trans &trans &kp BSPC
                &kp LCTRL &trans &kp F4 &kp F5 &kp F6 &kp F11   &trans       &trans      &trans       &trans &trans &trans
                &bt LSHFT &trans &kp F1 &kp F2 &kp F3 &kp F10   &trans       &trans      &trans       &trans &trans &trans
                                   &kp LGUI &mo NAV &kp SPACE   &kp RET &mo 2 &kp RALT
            >;
        };

        num {
            display-name = "NUM";
            bindings = <
                /* &mo TAB   &trans &kp F7 &kp F8 &kp F9 &kp F12   &kp C_VOL_DN &kp C_MUTE  &kp C_VOL_UP &trans &trans &kp BSPC */
                /* &kp LCTRL &trans &kp F4 &kp F5 &kp F6 &kp F11   &trans       &trans      &trans       &trans &trans &trans */
                /* &bt LSHFT &trans &kp F1 &kp F2 &kp F3 &kp F10   &trans       &trans      &trans       &trans &trans &trans */
                /*                    &kp LGUI &mo NAV &kp SPACE   &kp RET &mo 2 &kp RALT */
/* ╭─────────────┬─────────────┬─────────────┬─────────────┬─────────────┬─────────────╮ ╭─────────────┬─────────────┬─────────────┬─────────────┬─────────────┬─────────────╮ */
     &trans        &trans        &trans        &trans        &trans        &trans        &kp KP_MULTIPLY &kp N7        &kp N8        &kp N9        &trans        &trans      
/* ├─────────────┼─────────────┼─────────────┼─────────────┼─────────────┼─────────────┤ ├─────────────┼─────────────┼─────────────┼─────────────┼─────────────┼─────────────┤ */
     &trans        &trans        &trans        &trans        &trans        &trans          &kp BSLH      &kp N4        &kp N5        &kp N6        &trans        &trans      
/* ├─────────────┼─────────────┼─────────────┼─────────────┼─────────────┼─────────────┤ ├─────────────┼─────────────┼─────────────┼─────────────┼─────────────┼─────────────┤ */
     &trans        &trans        &trans        &trans        &trans        &trans          &kp PLUS      &kp N1        &kp N2        &kp N3        &trans        &trans      
/* ╰─────────────┴─────────────┴─────────────┴─────────────┼─────────────┼─────────────┤ ├─────────────┼─────────────┼─────────────┴─────────────┴─────────────┴─────────────╯ */
                                               &trans        &trans        &trans          &kp EQUAL     &kp MINUS     &kp N0
/*                                           ╰─────────────┴─────────────┴─────────────╯ ╰─────────────┴─────────────┴─────────────╯ */
            >;
        };

        mou {
            display-name = "MOU";
            bindings = <
/* ╭─────────────┬─────────────┬─────────────┬─────────────┬─────────────┬─────────────╮ ╭─────────────┬─────────────┬─────────────┬─────────────┬─────────────┬─────────────╮ */
     &trans        &trans        &trans        &trans        &trans        &trans          &trans        &trans        &mmv MOVE_UP  &trans        &trans        &trans      
/* ├─────────────┼─────────────┼─────────────┼─────────────┼─────────────┼─────────────┤ ├─────────────┼─────────────┼─────────────┼─────────────┼─────────────┼─────────────┤ */
     &trans        &trans        &trans        &trans        &mkp LCLK     &mkp RCLK      &msc SCRL_UP &mmv MOVE_LEFT &mmv MOVE_DOWN &mmv MOVE_RIGHT &trans       &trans      
/* ├─────────────┼─────────────┼─────────────┼─────────────┼─────────────┼─────────────┤ ├─────────────┼─────────────┼─────────────┼─────────────┼─────────────┼─────────────┤ */
     &trans        &trans        &trans        &trans        &trans        &trans        &msc SCRL_DOWN  &trans        &trans        &trans        &trans        &trans      
/* ╰─────────────┴─────────────┴─────────────┴─────────────┼─────────────┼─────────────┤ ├─────────────┼─────────────┼─────────────┴─────────────┴─────────────┴─────────────╯ */
                                               &trans        &trans        &trans        &msc SCRL_LEFT &msc SCRL_RIGHT &trans
/*                                           ╰─────────────┴─────────────┴─────────────╯ ╰─────────────┴─────────────┴─────────────╯ */
            >;
        };
    };
};

/* ╭─────────────┬─────────────┬─────────────┬─────────────┬─────────────┬─────────────╮ ╭─────────────┬─────────────┬─────────────┬─────────────┬─────────────┬─────────────╮ */
     /* &trans        &trans        &trans        &trans        &trans        &trans          &trans        &trans        &trans        &trans        &trans        &trans       */
/* ├─────────────┼─────────────┼─────────────┼─────────────┼─────────────┼─────────────┤ ├─────────────┼─────────────┼─────────────┼─────────────┼─────────────┼─────────────┤ */
     /* &trans        &trans        &trans        &trans        &trans        &trans          &trans        &trans        &trans        &trans        &trans        &trans       */
/* ├─────────────┼─────────────┼─────────────┼─────────────┼─────────────┼─────────────┤ ├─────────────┼─────────────┼─────────────┼─────────────┼─────────────┼─────────────┤ */
     /* &trans        &trans        &trans        &trans        &trans        &trans          &trans        &trans        &trans        &trans        &trans        &trans       */
/* ╰─────────────┴─────────────┴─────────────┴─────────────┼─────────────┼─────────────┤ ├─────────────┼─────────────┼─────────────┴─────────────┴─────────────┴─────────────╯ */
                                               /* &trans        &trans        &trans          &trans        &trans        &trans */
/*                                           ╰─────────────┴─────────────┴─────────────╯ ╰─────────────┴─────────────┴─────────────╯ */
